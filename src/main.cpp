#include <Arduino.h>
#include <SPI.h>
#include <Wire.h>
#include <Adafruit_GFX.h>
#include <Adafruit_SSD1306.h>
#include <WiFi.h>
#include <esp_now.h>

uint8_t mac_peer[] = {0x8C, 0xAA, 0xB5, 0x78, 0x77, 0x4B};
esp_now_peer_info_t peer;

typedef struct message {
   int red;
   int green;
};
struct message myMessage;

#define SCREEN_WIDTH 128
#define SCREEN_HEIGHT 32
#define accpotpin 32
#define servopotpin 35

int acc, servo, accheight, servoheight, firstmap, secondmap = 0;
char marcha[] = "";
u_int16_t x = 0;

#define OLED_RESET     -1
#define SCREEN_ADDRESS 0x3C
Adafruit_SSD1306 display(SCREEN_WIDTH, SCREEN_HEIGHT, &Wire, OLED_RESET);

const unsigned char epd_bitmap_New_Project [] PROGMEM = {
	0x00, 0xc3, 0x00, 0x00, 0x00, 0x00, 0x00, 0x00, 0x00, 0x00, 0x00, 0x00, 0x00, 0x00, 0x00, 0x00, 
	0x03, 0xff, 0xbf, 0x80, 0x00, 0x00, 0x00, 0x00, 0x00, 0x00, 0x00, 0x00, 0x00, 0x00, 0x00, 0x00, 
	0x03, 0xbf, 0x83, 0x00, 0x00, 0x00, 0x00, 0x00, 0x00, 0x00, 0x00, 0x00, 0x00, 0x00, 0x00, 0x00, 
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	0xff, 0xd1, 0xff, 0xff, 0x1f, 0xe0, 0x00, 0x00, 0x00, 0x00, 0x00, 0x00, 0x00, 0x00, 0x00, 0x00
};

void dashboard(int var, int othervar) {
  display.clearDisplay();

  if (var <= 120){
    marcha[0] = 'R';
  } else if (var >= 220){
    marcha[0] = '3';
  } else if (var >= 180){
    marcha[0] = '2';
  } else if (var >= 140){
    marcha[0] = '1';
  } else {
    marcha[0] = 'N';
  }
  

  display.drawRoundRect(0, 5, 12, 26, display.height()/10, SSD1306_INVERSE);
  firstmap = map(var, 128, 255, 24, 0);
  display.fillRoundRect(1, 6, 10, 24, display.height()/10, SSD1306_INVERSE);
  display.fillRoundRect(1, 6, 10, firstmap, display.height()/10, SSD1306_BLACK);
  
  display.setTextSize(2);
  display.setTextColor(SSD1306_WHITE);
  display.setCursor(20,5);
  display.println(F(marcha));

  secondmap = map(othervar, 0, 255, 0, 114);
  display.fillRoundRect(secondmap, 29, 14, 3, display.height()/3, SSD1306_INVERSE);
  display.display();
}

void setup() {
  Serial.begin(115200);

  // SSD1306_SWITCHCAPVCC = generate display voltage from 3.3V internally
  if(!display.begin(SSD1306_SWITCHCAPVCC, SCREEN_ADDRESS)) {
    Serial.println(F("SSD1306 allocation failed"));
    for(;;); // Don't proceed, loop forever
  }

  display.clearDisplay();
  display.drawBitmap(0, 0, epd_bitmap_New_Project, 128, 32, WHITE);
 
  display.display();
  delay(1000);
  display.clearDisplay();

  WiFi.mode(WIFI_STA);
  Serial.print("Mac Address: ");
  Serial.print(WiFi.macAddress());
  Serial.println("ESP32 ESP-Now Broadcast");
  if (esp_now_init() != 0) {
    Serial.println("Problem during ESP-NOW init");
    return;
  }

  // esp_wifi_set_channel(chan,WIFI_SECOND_CHAN_NONE)
  memcpy(peer.peer_addr, mac_peer, 6);
  peer.channel = 0;
  peer.encrypt = 0;
  // Register the peer
  Serial.println("Registering a peer 1");
  if ( esp_now_add_peer(&peer) == ESP_OK) {
    Serial.println("Peer 1 added");
  }  
}

void loop() {
  acc = analogRead(accpotpin);
  servo = analogRead(servopotpin);

  accheight = map(acc, 0, 4095, 0, 255);
  servoheight = map(servo, 0, 4095, 0, 255);
  
  myMessage.red = accheight;
  myMessage.green = servoheight;
  esp_now_send(NULL, (uint8_t *) &myMessage, sizeof(myMessage));

  dashboard(servoheight, accheight);
  delay(10);
}

